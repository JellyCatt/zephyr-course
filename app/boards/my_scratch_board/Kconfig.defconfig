## app/boards/my_scratch_board/Kconfig.defconfig
```kconfig
if BOARD_MY_SCRATCH_BOARD

config USB_SELF_POWERED
	default n

endif # BOARD_MY_SCRATCH_BOARD
```

## app/boards/my_scratch_board/Kconfig.my_scratch_board
```kconfig
config BOARD_MY_SCRATCH_BOARD
	select SOC_RP2350A_M33 if BOARD_MY_SCRATCH_BOARD
  # select MY_SCRATCH_BOARD_EARLY_INIT
```

## app/boards/my_scratch_board/board.yml
```yaml
board:
  name: my_scratch_board
  full_name: My Scratch Board
  vendor: jellycat
  socs:
  - name: rp2350a
```

## app/boards/our_board/Kconfig.defconfig
```kconfig
# Copyright (c) 2024 Andrew Featherstone
# SPDX-License-Identifier: Apache-2.0

if BOARD_OUR_BOARD

config USB_SELF_POWERED
	default n

endif # BOARD_OUR_BOARD
```

## app/boards/our_board/Kconfig.our_board
```kconfig
# Copyright (c) 2024 Andrew Featherstone
# SPDX-License-Identifier: Apache-2.0

config BOARD_OUR_BOARD
	select SOC_RP2350A_M33 if BOARD_OUR_BOARD
```

## app/boards/our_board/board.yml
```yaml
board:
  name: our_board
  full_name: Very Our Board
  vendor: jellycat
  socs:
  - name: rp2350a
```
